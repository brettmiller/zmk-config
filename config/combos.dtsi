/*                KEY POSITIONS
     q   w   e   r   t      y   u   i   o   p
     a   s   d   f   g      h   j   k   l   ;
     z   x   c   v   b      n   m   ,   .   /
  .--------------------. .--------------------.
  |  0   1   2   3   4 | |  5   6   7   8   9 |
  | 10  11  12  13  14 | | 15  16  17  18  19 |
  | 20  21  22  23  24 | | 25  26  27  28  29 |
  '-----------. 30  31 | | 32  33 .-----------'
              '--------' '--------'            */

combos {
  compatible = "zmk,combos";

  // global combos (on all layers)
  #define COMBO(NAME, BINDINGS, KEYPOS) \
    combo_##NAME { bindings = <BINDINGS>; \
      key-positions = <KEYPOS>; \
    };

  // combos on defined layer(s)
  #define COMBO_L(NAME, BINDINGS, KEYPOS, LAYERS) \
    combo_##NAME { bindings = <BINDINGS>; \
      key-positions = <KEYPOS>; \
      layers = <LAYERS>; \
    };

  // can't get the COMBO_L macro to work correctly (only the first one defined works)
  // defining per layer combos here, w/o the macro, until that can be resolved
  combo_jkCol { bindings = <&kp COLN>; // :
    key-positions = <16 17>;
    layers = <BASE>;
  };

  combo_navEnter { bindings = <&kp ENTER>;  // nav layer Enter on jk (down & up on nav)
    key-positions = <16 17>; 
    layers = <NUM>;
  };


  COMBO(fa1EH,      &sk LS(LCTRL), 10 13) // OSM EH(shift+ctrl) on left home row (matching mods)
  COMBO(jcln1EH,    &sk RS(RCTRL), 16 19) // OSM EH(shift+ctrl) on right home row (matching mods)
  COMBO(fvDquot,    &kp DQT,       13 23) // double quote
  COMBO(weCaps,     &caps_word,      1 2)
  COMBO(wsAt,       &kp AT,        1 11)  // @
  COMBO(edHash,     &kp HASH,      2 12)  // #
  COMBO(rfEqual,    &kp EQUAL,     3 13)  // =
  COMBO(tgPerc,     &kp PRCNT,     4 14)  // %
  COMBO(yhGrv,      &kp GRAVE,     5 15)  // `
  COMBO(jmQuot,     &kp SQT,       6 16)  // single quote
  COMBO(uiEsc,      &kp ESC,       6 7)
  COMBO(ioPipe,     &kp PIPE,      7 8)   // |
  COMBO(olBang,     &kp EXCL,      7 17)  // !
  COMBO(ikSplat,    &kp ASTRK,     8 18)  // *
  COMBO(pclnTild,   &kp TILDE,     9 19)  // ~
  COMBO(asEsc,      &kp ESC,       10 11)
  COMBO(sdBspc,     &kp BSPC,      11 12)
  COMBO(dfDel,      &kp DEL,       12 13)
  COMBO(mtparens,   &mt RPAR LPAR, 12 23) // tapped (, held )
  COMBO(fgTab,      &kp TAB,       13 14)
  COMBO(yhCaret,    &kp CARET,     15 16) // ^
  COMBO(jmAmp,      &kp AMPS,      16 26) // &
  //COMBO_L(jkCol,    &kp COLN,      16 17, BASE) // :
  //COMBO_L(numEnter, &kp ENTER,     16 17, NUM) // num/nav layer Enter on jk (down & up on num)
  COMBO(klDlr,      &kp DLLR,      17 18) // $
  COMBO(dquotes,    &kp DQT,       17 26) // "
  COMBO(lSclnBspc,  &kp BSPC,      18 19)
  COMBO(mcUnds,     &kp UNDER,     22 23) // _
  COMBO(xcDash,     &kp MINUS,     26 27) // -
  COMBO(comperBsls, &kp BSLH,      27 28) // \

  COMBO(bothquote,   &macro_quotes,   16 18) // '' with cursor in between
  COMBO(bothquote2,  &macro_quotes,   26 18) // '' with cursor in between
  COMBO(bothdquote,  &macro_dquotes,  6 8) // "" with cursor in between
  COMBO(bothbrc,     &macro_braces,   1 3) // {} with cursor in between
  COMBO(bothparens,  &macro_parens,   11 13) // () with cursor in between
  COMBO(bothparens2, &macro_parens,   11 23) // () with cursor in between
  COMBO(bothbrkt,    &macro_brackets, 21 23) // [] with cursor in between

  //COMBO(bt_0,       &bt BT_SEL 0,  20 21 22) // Set Bluetooth profile to #
  //COMBO(bt_1,       &bt BT_SEL 1,  21 22 23) // Set Bluetooth profile to #
  //COMBO(bt_2,       &bt BT_SEL 2,  22 23 24) // Set Bluetooth profile to #
  //COMBO(bt_clr,     &bt BT_CLR,    20 21 22 23) // clear Bluetooth bond info for current profile
};
